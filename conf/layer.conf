## conf/layer.conf
```bitbake
# We have a conf and classes directory, add to BBPATH
BBPATH .= ":${LAYERDIR}"

# We have recipes-* directories, add to BBFILES
BBFILES += "${LAYERDIR}/recipes-*/*/*.bb \
            ${LAYERDIR}/recipes-*/*/*.bbappend"

BBFILE_COLLECTIONS += "meta-camelpi"
BBFILE_PATTERN_meta-camelpi = "^${LAYERDIR}/"
BBFILE_PRIORITY_meta-camelpi = "6"

LAYERDEPENDS_meta-camelpi = "core"
LAYERSERIES_COMPAT_meta-camelpi = "whinlatter"

DISTRO_FEATURES:remove = "pulseaudio"

# Set hostname for Camel Audio system
hostname:pn-base-files = "camel-audio"

# Use initramfs WIC template for image generation
WKS_FILE = "sdimage-camelpi-initramfs.wks"
WKS_FILE_DEPENDS_BOOTIMG_PARTITION = ""

# Bundle initramfs into kernel during build
INITRAMFS_IMAGE = "camelpi-initramfs-image"
INITRAMFS_IMAGE_BUNDLE = "1"
BOOT_SPACE = "524288"
INITRAMFS_MAXSIZE = "400000"
IMAGE_FSTYPES:pn-${INITRAMFS_IMAGE} = "${INITRAMFS_FSTYPES}"
IMAGE_NAME_SUFFIX:pn-${INITRAMFS_IMAGE} = ""

# Enable WIC image generation only for camelpi-image (main image)
IMAGE_FSTYPES:pn-camelpi-image = "wic.bz2 wic.bmap"

WIC_CREATE_EXTRA_ARGS = "--no-fstab-update"
```

## wic/sdimage-auris-initramfs.wks
```
# short-description: Create Auris Pi RAM boot SD card image
# long-description: Creates a partitioned SD card image with initramfs for Auris Pi.
# Boot from RAM with kernel and initramfs in the boot partition.

part /boot --source bootimg-partition --ondisk mmcblk0 --fstype=vfat --label boot --active --align 4096 --size 512 --extra-space 0
```

## wic/sdimage-camelpi-initramfs.wks
```
# short-description: Create Camel Audio RAM boot SD card image
# long-description: Creates a partitioned SD card image with initramfs for Camel Audio.
# Boot from RAM with kernel and initramfs in the boot partition.

part /boot --source bootimg-partition --ondisk mmcblk0 --fstype=vfat --label boot --active --align 4096 --size 512 --extra-space 0
```
